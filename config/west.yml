## config/west.yml
```yaml
manifest:
  remotes:
    - name: zmkfirmware
      url-base: https://github.com/zmkfirmware
    - name: badjeff
      url-base: https://github.com/badjeff
    - name: carrefinho
      url-base: https://github.com/carrefinho

  projects:
    - name: zmk
      remote: zmkfirmware
      revision: 4ec69cb
      import: app/west.yml

    - name: zmk-pmw3610-driver
      remote: badjeff
      revision: 77635ba

    - name: prospector-zmk-module
      remote: carrefinho
      revision: 67425b7

  self:
    path: config
```
